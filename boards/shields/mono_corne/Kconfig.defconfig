## config/west.yml
```yaml
manifest:
  remotes:
    - name: zmkfirmware
      url-base: https://github.com/zmkfirmware
    - name: divsmith
      url-base: https://github.com/divsmith
    - name: rschenk
      url-base: https://github.com/rschenk
    - name: nmunnich
      url-base: https://github.com/nmunnich
    - name: urob
      url-base: https://github.com/urob
  projects:
    - name: zmk
      remote: zmkfirmware
      revision: main
      import: app/west.yml 
    - name: zmk-component-raytac-dongle
      remote: rschenk
      revision: main
    - name: zmk-component-rp2040-zero
      remote: nmunnich
      revision: main
    - name: zmk-adaptive-key
      remote: urob
      revision: main
  self:
    path: config
```
