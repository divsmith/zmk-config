/*
 * Base combos for ZMK keymaps
 *
 * This file defines common combos used across different keyboards.
 */

/ {
  combos {
    compatible = "zmk,combos";

    combo_caps_word {
      timeout - ms = <50>;
      key - positions = <15 20>;
      bindings = <&caps_word>;
    };
  };
};